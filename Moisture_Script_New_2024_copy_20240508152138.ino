#include <ESP8266WiFi.h>
#include <ESP8266WebServer.h>

int soilmoisturepercent;
int soilMoistureValue;
int relay = 12; 
int humifier = 9;
// #include "thingProperties.h"
#include <SPI.h>
#include <Wire.h>
#include <Adafruit_GFX.h>
#include <Adafruit_SH110X.h>

#define OLED_MOSI     13
#define OLED_CLK      14
#define OLED_DC       5
#define OLED_CS       15
#define OLED_RST      4

const int image_with =  48;    
const int image_height = 48;

const int lbl_curs_x =  56;    
const int lbl_curs_y = 0;

int low_thredhold = 30;
int external_value = 0;



// Create the OLED display
Adafruit_SH1106G display = Adafruit_SH1106G(128, 64,OLED_MOSI, OLED_CLK, OLED_DC, OLED_RST, OLED_CS);


const int AirValue = 622;   //you need to replace this value with Value_1
const int WaterValue = 252;  //you need to replace this value with Value_2
const int SensorPin = A0;

/********************************************************************************************************************************/

//Blessed***********************/
const unsigned char PROGMEM frame04 [] = {0x00, 0x00, 0x00, 0x00, 0x00, 0x00, 0x00, 0x00, 0x00, 0x00, 0x00, 0x00, 0x00,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 0x00, 0x00};

const unsigned char PROGMEM frame14 [] = {0x00, 0x00, 0x00, 0x00, 0x00, 0x00, 0x00, 0x00, 0x00, 0x00, 0x00, 0x00, 0x00,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 0x00, 0x00};

const unsigned char PROGMEM frame24 [] = {0x00, 0x00, 0x00, 0x00, 0x00, 0x00, 0x00, 0x00, 0x00, 0x00, 0x00, 0x00, 0x00,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 0x00, 0x00};

const unsigned char PROGMEM frame34 [] = {0x00, 0x00, 0x00, 0x00, 0x00, 0x00, 0x00, 0x00, 0x00, 0x00, 0x00, 0x00, 0x00,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 0x00, 0x00};

const unsigned char PROGMEM frame44 [] = {0x00, 0x00, 0x00, 0x00, 0x00, 0x00, 0x00, 0x00, 0x00, 0x00, 0x00, 0x00, 0x00,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 0x00, 0x00};

const unsigned char PROGMEM frame54 [] = {0x00, 0x00, 0x00, 0x00, 0x00, 0x00, 0x00, 0x00, 0x00, 0x00, 0x00, 0x00, 0x00,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 0x00, 0x00};

const unsigned char PROGMEM frame64 [] = {0x00, 0x00, 0x00, 0x00, 0x00, 0x00, 0x00, 0x00, 0x00, 0x00, 0x00, 0x00, 0x00,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 0x00, 0x00};

const unsigned char PROGMEM frame74 [] = {0x00, 0x00, 0x00, 0x00, 0x00, 0x00, 0x00, 0x00, 0x00, 0x00, 0x00, 0x00, 0x00,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 0x00, 0x00};

const unsigned char PROGMEM frame94 [] = {0x00, 0x00, 0x00, 0x00, 0x00, 0x00, 0x00, 0x00, 0x00, 0x00, 0x00, 0x00, 0x00,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 0x00, 0x00};

//******CRYING/
const unsigned char PROGMEM frame05 [] = {0x00, 0x00, 0x00, 0x00, 0x00, 0x00, 0x00, 0x00, 0x00, 0x00, 0x00, 0x00, 0x00,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 0x00, 0x00};

const unsigned char PROGMEM frame25 [] = {0x00, 0x00, 0x00, 0x00, 0x00, 0x00, 0x00, 0x00, 0x00, 0x00, 0x00, 0x00, 0x00,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 0x00, 0x00};

const unsigned char PROGMEM frame35 [] = {0x00, 0x00, 0x00, 0x00, 0x00, 0x00, 0x00, 0x00, 0x00, 0x00, 0x00, 0x00, 0x00,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 0x00, 0x00};

const unsigned char PROGMEM frame45 [] = {0x00, 0x00, 0x00, 0x00, 0x00, 0x00, 0x00, 0x00, 0x00, 0x00, 0x00, 0x00, 0x00,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 0x00, 0x00};

const unsigned char PROGMEM frame55 [] = {0x00, 0x00, 0x00, 0x00, 0x00, 0x00, 0x00, 0x00, 0x00, 0x00, 0x00, 0x00, 0x00,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 0x00, 0x00};

const unsigned char PROGMEM frame65 [] = {0x00, 0x00, 0x00, 0x00, 0x00, 0x00, 0x00, 0x00, 0x00, 0x00, 0x00, 0x00, 0x00,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 0x00, 0x00};

const unsigned char PROGMEM frame75 [] = {0x00, 0x00, 0x00, 0x00, 0x00, 0x00, 0x00, 0x00, 0x00, 0x00, 0x00, 0x00, 0x00,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 0x00, 0x00};

const unsigned char PROGMEM frame85 [] = {0x00, 0x00, 0x00, 0x00, 0x00, 0x00, 0x00, 0x00, 0x00, 0x00, 0x00, 0x00, 0x00,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 0x00, 0x00};

const unsigned char PROGMEM frame95 [] = {0x00, 0x00, 0x00, 0x00, 0x00, 0x00, 0x00, 0x00, 0x00, 0x00, 0x00, 0x00, 0x00,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 0x00, 0x00};
//confused
const unsigned char PROGMEM framec [] = {0x00, 0x00, 0x00, 0x00, 0x00, 0x00, 0x00, 0x00, 0x00, 0x00, 0x00, 0x00, 0x00,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 0x00, 0x00};

/********************************************************************************************************************************/

ESP8266WebServer server(80);
void setup() {
  // Initialize serial and wait for port to open:
  Serial.begin(115200);

  display.begin(0, true); // we dont use the
  // display.begin(SSD1306_SWITCHCAPVCC, 0x3C); //initialize with the I2C addr 0x3C (128x64)
  display.clearDisplay();
  // display.setTextColor(WHITE);
  display.setTextSize(1);
  display.setTextColor(1);
  display.setCursor(0, 0);

  pinMode(relay, OUTPUT);
  pinMode(humifier, OUTPUT);
  
  WiFi.mode(WIFI_AP);
  WiFi.softAP("GLASTRA_AP", "password");

  // Set up the server routes
  server.on("/", HTTP_GET, handleRoot);
  server.on("/setThreshold", HTTP_GET, handleSetThreshold);
  server.on("/getThreshold", HTTP_GET, handleGetThreshold);
  server.on("/setExternalSensor", HTTP_GET, handleSetExternalSensor);
  server.on("/getMoisture", HTTP_GET, handleGetMoisture);

  server.begin();
}

void loop() {
  // Your code here
  server.handleClient();

  soilMoistureValue = analogRead(SensorPin);  //put Sensor insert into soil
  int percent = map(soilMoistureValue, AirValue, WaterValue, 0, 100);
  
  digitalWrite(relay, LOW);

  if (percent < 0) {
    soilmoisturepercent = 0;
  }

  else if (percent > 100) {
    soilmoisturepercent = 100;
  }

  else if (percent >= 0 && percent <= 100) {
    soilmoisturepercent = percent;
  }

  digitalWrite(humifier, LOW); // 

  if (soilmoisturepercent >= 0 && soilmoisturepercent <= low_thredhold)
  {
    digitalWrite(relay, HIGH); // Turn the relay on
    digitalWrite(humifier, HIGH); // 

    display.clearDisplay();
    display.drawBitmap(0, 0, frame05, image_with, image_height, 1);
    infoPanel(low_thredhold, soilMoistureValue,soilmoisturepercent,30);

    display.clearDisplay();
    display.drawBitmap(0, 0, frame25, image_with, image_height, 1);
    infoPanel(low_thredhold, soilMoistureValue,soilmoisturepercent,30);

    display.clearDisplay();
    display.drawBitmap(0, 0, frame35, image_with, image_height, 1);
    infoPanel(low_thredhold, soilMoistureValue,soilmoisturepercent,30);

    display.clearDisplay();
    display.drawBitmap(0, 0, frame45, image_with, image_height, 1);
    infoPanel(low_thredhold, soilMoistureValue,soilmoisturepercent,30);

    display.clearDisplay();
    display.drawBitmap(0, 0, frame55, image_with, image_height, 1);
    infoPanel(low_thredhold, soilMoistureValue,soilmoisturepercent,30);

    display.clearDisplay();
    display.drawBitmap(0, 0, frame65, image_with, image_height, 1);
    infoPanel(low_thredhold, soilMoistureValue,soilmoisturepercent,30);

    display.clearDisplay();
    display.drawBitmap(0, 0, frame75, image_with, image_height, 1);
    infoPanel(low_thredhold, soilMoistureValue,soilmoisturepercent,30);

    display.clearDisplay();
    display.drawBitmap(0, 0, frame85, image_with, image_height, 1);
    infoPanel(low_thredhold, soilMoistureValue,soilmoisturepercent,30);

    display.clearDisplay();
    display.drawBitmap(0, 0, frame95, image_with, image_height, 1);
    infoPanel(low_thredhold, soilMoistureValue,soilmoisturepercent,30);
  }
  else if (soilmoisturepercent >= low_thredhold+1 && soilmoisturepercent <= 100)
  {
    digitalWrite(relay, LOW); // Turn the relay on
    //Blessed
    display.clearDisplay();
    display.drawBitmap(0, 0, frame04, image_with, image_height, 1);
    infoPanel(low_thredhold, soilMoistureValue,soilmoisturepercent,50);


    display.clearDisplay();
    display.drawBitmap(0, 0, frame14, image_with, image_height, 1);
    infoPanel(low_thredhold, soilMoistureValue,soilmoisturepercent,30);

    display.clearDisplay();
    display.drawBitmap(0, 0, frame24, image_with, image_height, 1); 
    infoPanel(low_thredhold, soilMoistureValue,soilmoisturepercent,30);

    display.clearDisplay();
    display.drawBitmap(0, 0, frame34, image_with, image_height, 1);
    infoPanel(low_thredhold, soilMoistureValue,soilmoisturepercent,35);

    display.clearDisplay();
    display.drawBitmap(0, 0, frame44, image_with, image_height, 1);
    infoPanel(low_thredhold, soilMoistureValue,soilmoisturepercent,30);


    display.clearDisplay();
    display.drawBitmap(0, 0, frame54, image_with, image_height, 1);
    infoPanel(low_thredhold, soilMoistureValue,soilmoisturepercent,30);

    display.clearDisplay();
    display.drawBitmap(0, 0, frame64, image_with, image_height, 1);
    infoPanel(low_thredhold, soilMoistureValue,soilmoisturepercent,35);

    display.clearDisplay();
    display.drawBitmap(0, 0, frame74, image_with, image_height, 1);
    infoPanel(low_thredhold, soilMoistureValue,soilmoisturepercent,40);

    display.clearDisplay();
    display.drawBitmap(0, 0, frame94, image_with, image_height, 1);
    infoPanel(low_thredhold, soilMoistureValue,soilmoisturepercent,80);
  }
}

void handleRoot() {
  server.send(200, "text/plain", "Hello from ESP8266!");
}

void handleSetThreshold() {
  if (server.hasArg("threshold")) {
    low_thredhold = server.arg("threshold").toInt();
    server.send(200, "text/plain", "Threshold set successfully");
  } else {
    server.send(400, "text/plain", "Bad Request");
  }
}

void handleSetExternalSensor() {
  if (server.hasArg("value")) {
    external_value = server.arg("value").toInt();
    server.send(200, "text/plain", "Sensor value set successfully");
  } else {
    server.send(400, "text/plain", "Bad Request");
  }
}




void handleGetMoisture() {
  String response = String(soilmoisturepercent);
  server.send(200, "text/plain", response);
}


void handleGetThreshold() {
  String response = String(low_thredhold);
  server.send(200, "text/plain", response);
}


void infoPanel(int lowthredhold, int moistureValue, int moisturePercentage, int delayTime)
{
  display.setCursor(lbl_curs_x, lbl_curs_y);
  display.print("RH:" + String(soilmoisturepercent));
  display.println(" %");
  display.setCursor(lbl_curs_x, lbl_curs_y+15);
  display.print("Raw:" + String(moistureValue));
  display.setCursor(lbl_curs_x, lbl_curs_y+30);
  display.print("L-Thr:" + String(lowthredhold));
  display.println(" %");
  display.setCursor(lbl_curs_x, lbl_curs_y+45);
  display.print("EXT:" + String(external_value));
  display.println(" %");
  display.display();
  delay(delayTime);

}